/* 
  Genius 
*/

#include "notes.h"

#define GREEN_LED 9
#define YELLOW_LED 7
#define RED_LED 5
#define BLUE_LED 3

#define GREEN_BTN 8
#define YELLOW_BTN 6
#define RED_BTN 4
#define BLUE_BTN 2

#define GREEN_SND NOTE_C6
#define YELLOW_SND NOTE_E6
#define RED_SND NOTE_G6
#define BLUE_SND NOTE_B6

#define PIEZO 13

#define UNDEFINED -1

#define SEQ_SIZE 6

#define ON_TIME 500
#define OFF_TIME 500
#define BLINK_TIME 250

enum States { READY_TO_RUN, WAITING_USER, DONE_SUCCESS, DONE_FAILURE };

const int LED_SUCCESS_SEQ[] = { GREEN_LED, YELLOW_LED, RED_LED, BLUE_LED, RED_LED, YELLOW_LED };
const int LED_PORTS[] = { GREEN_LED, YELLOW_LED, RED_LED, BLUE_LED };
const int BTN_PORTS[] = { GREEN_BTN, YELLOW_BTN, RED_BTN, BLUE_BTN };
const int BTN_NOTES[] = { GREEN_SND, YELLOW_SND, RED_SND, BLUE_SND };
const int LED_QUANT = sizeof(LED_PORTS)/sizeof(int);
const int SUCCESS_SEQ_QUANT = sizeof(LED_SUCCESS_SEQ)/sizeof(int);

// Game songs
const int MARIO_THEME[] = {11, NOTE_E4, 8, NOTE_E4, 8, NOTE_H, 8, NOTE_E4, 8, NOTE_H, 8, NOTE_C4, 8, NOTE_E4, 8, NOTE_H, 8, NOTE_G4, 8, NOTE_H, 3, NOTE_G3, 8};
const int MARIO_FLAGPOLE[] = {27, NOTE_G2, 10, NOTE_C3, 10, NOTE_E3, 10, NOTE_G3, 10, NOTE_C4, 10, NOTE_E4, 10, NOTE_G4, 3, NOTE_E4, 3, NOTE_GS2, 10, NOTE_C3, 10, NOTE_DS3, 10, NOTE_GS3, 10, NOTE_C4, 10, NOTE_DS4, 10, NOTE_GS4, 3, NOTE_DS4, 3, NOTE_AS2, 10, NOTE_D3, 10, NOTE_F3, 10, NOTE_AS3, 10, NOTE_D4, 10, NOTE_F4, 10, NOTE_AS4, 3, NOTE_B4, 10, NOTE_B4, 10, NOTE_B4, 10, NOTE_C5, 2};
const int MARIO_DEATH[] = {17, NOTE_C4, 32, NOTE_CS4, 32, NOTE_D4, 16, NOTE_H, 4, NOTE_H, 2, NOTE_B3, 8, NOTE_F4, 8, NOTE_H, 8, NOTE_F4, 8, NOTE_F4, 6, NOTE_E4, 6, NOTE_D4, 6, NOTE_C4, 8, NOTE_E3, 8, NOTE_H, 8, NOTE_E3, 8, NOTE_C3, 8};
const int MARIO_GAMEOVER[] = {15, NOTE_C4, 8, NOTE_H, 8, NOTE_H, 8, NOTE_G3, 8, NOTE_H, 4, NOTE_E3, 4, NOTE_A3, 6, NOTE_B3, 6, NOTE_A3, 6, NOTE_GS3, 6, NOTE_AS3, 6, NOTE_GS3, 6, NOTE_G3, 8, NOTE_F3, 8, NOTE_G3, 4};

int gameSeq[SEQ_SIZE];
int turns = 0;
int responses = 0;
int finishSoundPlayed = 0;

void setup() {
  Serial.begin(9600);
  randomSeed(analogRead(0));
  initPorts();
  initializeGame();
}

void initPorts() {
  for(int i = 0; i < LED_QUANT; i++) {
    pinMode(LED_PORTS[i], OUTPUT);
    pinMode(BTN_PORTS[i], INPUT_PULLUP);
  }
  pinMode(PIEZO, OUTPUT);
}

void initializeGame() {
  Serial.println("Starting game");
  
  int turns = 0;
  int responses = 0;
  int finishSoundPlayed = 0;
  
  for(int i = 0; i < SEQ_SIZE;) {
    gameSeq[i] = random(LED_QUANT);
    if(i == 0 || gameSeq[i] != gameSeq[i-1]) { // Improving drasticaly the quality of the game
      i++;
    }
  }
  
  playSequence(MARIO_THEME);
  delay(500);
}

void loop() {
  switch(currentState()) {
    case READY_TO_RUN: stateReadyToRun(); break;
    case WAITING_USER: stateWaitingUser(); break;
    case DONE_SUCCESS: stateDoneSuccess(); break;
    case DONE_FAILURE: stateDoneFailure(); break;
  }
}

///////////////////////////////////////////////////////

void stateReadyToRun() {
  turns++;
  if(turns > SEQ_SIZE) return;
  if(turns > 1) {
    delay(1000);
  }
  responses = 0;
  for(int i = 0; i < turns; i++) {
    showAnswerFeedback(gameSeq[i]);
    delay(OFF_TIME);
  }
}

void stateWaitingUser() {
  int answer = readUserAnswer();
  if(answer == UNDEFINED) return;
  
  showAnswerFeedback(answer);
  
  if(answer == gameSeq[responses]) {
    responses++;
  } else {
    turns = SEQ_SIZE + 2; // Finish game
  }
}

void stateDoneSuccess() {
  if(!finishSoundPlayed) {
    playSequence(MARIO_FLAGPOLE);
    finishSoundPlayed = 1;
  }
  for(int i = 0; i < SUCCESS_SEQ_QUANT; i++) {
    digitalWrite(LED_SUCCESS_SEQ[i], HIGH);
    delay(BLINK_TIME);
    digitalWrite(LED_SUCCESS_SEQ[i], LOW); 
  }
}

void stateDoneFailure() {
  if(!finishSoundPlayed) {
    playSequence(MARIO_DEATH);
    delay(500);
    playSequence(MARIO_GAMEOVER);
    finishSoundPlayed = 1;
  }
  for(int v = LOW; v <= HIGH; v++) {
    for(int i = 0; i < LED_QUANT; i++) {
      digitalWrite(LED_PORTS[i], v);
    }
    delay(BLINK_TIME);
  }
}

/////////////////////////////////////////////////////

void showAnswerFeedback(int i) {
  int port = LED_PORTS[i];
  digitalWrite(port, HIGH);
  playSound(BTN_NOTES[i], 10);
  int restDelay = ON_TIME - 100 * 1.30;
  if(restDelay > 0) delay(restDelay);
  digitalWrite(port, LOW);
}

int readUserAnswer() {
  for(int i = 0; i < LED_QUANT; i++) {
    if(!digitalRead(BTN_PORTS[i])) {
      return i;
    }
  }
  return UNDEFINED;
}

int currentState() {
  if(turns <= SEQ_SIZE && responses == turns) {
    return READY_TO_RUN;
  } else if(turns <= SEQ_SIZE) {
    return WAITING_USER;
  } else if(responses == SEQ_SIZE){
    return DONE_SUCCESS;
  } else {
    return DONE_FAILURE;
  }
}

void playSound(int freq, int duration) {
  tone(PIEZO, freq, 1000/duration);                   // Play the single note
  delay((1000/duration) * 1.30);                      // Delay for the specified time
  noTone(PIEZO);                                      // Silence the note that was playing
}

void playSequence(int* seq) {
  for (int i = 1; i < (seq[0] * 2 + 1); i = i + 2) {  // Run through the notes one at a time
    playSound(seq[i], seq[i + 1]);                    // Play notes
  }
}